/*
 * Color_Sensor.cpp
 *
 * Created: 23-06-2014 14:45:11
 *  Author: Yash Joshi
 
This experiment demonstrates the use of Color Sensor.

Concepts covered: External Interrupts

Micro-controller pins used:

PORTD0 (INT0): External Interrupt used to count the number of pulses generated by the color sensor

PORTD4 & PORTD5: Control the S0 and S1 pins of the color sensor to choose a scaling factor

PORTD6 & PORTD7: Control S2 and S3 pins of the color sensor to choose the color filter.   

Note:

1. Make sure that in the configuration options following settings are
done for proper operation of the code

Micro-controller: atmega2560
Frequency: 14745600
Optimization: -O0  (For more information read section: Selecting proper optimization
options below figure 2.22 in the Software Manual)

2.	It is observed that external interrupts does not work with the optimization level -Os

Connections:
 
 *Vcc is connected on servo pod pin 7
 *Vdd is connected on servo pod pin 6
 *Output of the sensor is connected to PD0 (INT0) of Atmega 2560 i.e Pin 20 on expansion slot
 *S0 of the sensor is connected to PD4 of Atmega 2560 i.e Pin 25 on expansion slot
 *S1 of the sensor is connected to PD5 of Atmega 2560 i.e Pin 29 on expansion slot
 *S2 of the sensor is connected to PD6 of Atmega 2560 i.e Pin 33 on expansion slot
 *S3 of the sensor is connected to PD7 of Atmega 2560 i.e Pin 34 on expansion slot
 */ 


#define F_CPU 14745600


volatile unsigned long int pulse = 0; //to keep the track of the number of pulses generated by the color sensor
volatile unsigned long int red;       // variable to store the pulse count when read_red function is called
volatile unsigned long int blue;      // variable to store the pulse count when read_blue function is called
volatile unsigned long int green;     // variable to store the pulse count when read_green function is called


void color_sensor_pin_config(void)
{
	DDRD  = DDRD | 0xFE; //set PD0 as input for color sensor output
	PORTD = PORTD | 0x01;//Enable internal pull-up for PORTD 0 pin
}


void color_sensor_pin_interrupt_init(void) //Interrupt 0 enable
{
	cli(); //Clears the global interrupt
	EICRA = EICRA | 0x02; // INT0 is set to trigger with falling edge
	EIMSK = EIMSK | 0x01; // Enable Interrupt INT0 for color sensor
	sei(); // Enables the global interrupt
}

//ISR for color sensor
ISR(INT0_vect)
{
	pulse++; //increment on receiving pulse from the color sensor
}



//Filter Selection
void filter_red(void)    //Used to select red filter
{
	//Filter Select - red filter
	PORTD = PORTD & 0xBF; //set S2 low
	PORTD = PORTD & 0x7F; //set S3 low
}

void filter_green(void)	//Used to select green filter
{
	//Filter Select - green filter
	PORTD = PORTD | 0x40; //set S2 High
	PORTD = PORTD | 0x80; //set S3 High
}

void filter_blue(void)	//Used to select blue filter
{
	//Filter Select - blue filter
	PORTD = PORTD & 0xBF; //set S2 low
	PORTD = PORTD | 0x80; //set S3 High
}

void filter_clear(void)	//select no filter
{
	//Filter Select - no filter
	PORTD = PORTD | 0x40; //set S2 High
	PORTD = PORTD & 0x7F; //set S3 Low
}

//Color Sensing Scaling
void color_sensor_scaling()		//This function is used to select the scaled down version of the original frequency of the output generated by the color sensor, generally 20% scaling is preferable, though you can change the values as per your application by referring datasheet
{
	//Output Scaling 20% from datasheet
	//PORTD = PORTD & 0xEF;
	PORTD = PORTD | 0x10; //set S0 high
	//PORTD = PORTD & 0xDF; //set S1 low
	PORTD = PORTD | 0x20; //set S1 high
}

void color(void)
{
    color_sensor_scaling();
	
      filter_green(); //select green filter
      pulse=0; //reset the count to 0
      _delay_ms(100); //capture the pulses for 100 ms or 0.1 second
      green = pulse;  //store the count in variable called green
       _delay_ms(100);
	  //Blue
	  filter_blue(); //select blue filter
	  pulse=0; //reset the count to 0
	  _delay_ms(100); //capture the pulses for 100 ms or 0.1 second
	  blue = pulse;  //store the count in variable called blue
	  //red
	  filter_red(); //select red filter
	  pulse=0; //reset the count to 0
	  _delay_ms(100); //capture the pulses for 100 ms or 0.1 second
	  red = pulse;  //store the count in variable called red
	  
	  if(red < threshold&& blue < threshold && green < threshold)
	  {
		  lcd_cursor(1,1);  //set the cursor on row 1, column 1
		  lcd_string("Black color"); // Display "Blue Pulses" on LCD
		  _delay_ms(1000);	// Display for 1000ms or 1 second
		  lcd_wr_command(0x01); //Clear the LCD 
		  
		  
	  }
	  else if(red> blue && red > green)
	  {
		  lcd_cursor(1,1);  //set the cursor on row 1, column 1
		  lcd_string("red color"); // Display "Blue Pulses" on LCD
		  _delay_ms(1000);	// Display for 1000ms or 1 second
		  lcd_wr_command(0x01); //Clear the LCD
		  close(150);
		  _delay_ms(2000);
		  servo_1_free();
		  servo_2_free();
		  align_north();
		  shortest_path(current,destred[redcount]);
		  current=destred[redcount++];
		  travel();
	  }
	  else if(blue> red && blue > green)
	  {
		  lcd_cursor(1,1);  //set the cursor on row 1, column 1
		  lcd_string("blue color"); // Display "Blue Pulses" on LCD
		  _delay_ms(1000);	// Display for 1000ms or 1 second
		  lcd_wr_command(0x01); //Clear the LCD
		  close(150);
		  _delay_ms(2000);
		  servo_1_free();
		  servo_2_free();
		  align_north();
		  shortest_path(current,destblue[bluecount]);
		  current=destblue[bluecount++];
		  lcd_print(1,10,current,4);
		  travel();
	  }
	  else if(green> blue && green> red)
	  {
		  lcd_cursor(1,1);  //set the cursor on row 1, column 1
		  lcd_string("green color"); // Display "Blue Pulses" on LCD
		  _delay_ms(1000);	// Display for 1000ms or 1 second
		  lcd_wr_command(0x01); //Clear the LCD
		  close(150);
		  _delay_ms(2000);
		  servo_1_free();
		  servo_2_free();
		  align_north();
		  shortest_path(current,destgreen[greencount]);
		  current=destgreen[greencount++];
		  lcd_print(1,10,current,4);
		  travel();
	  }
	   
    
}